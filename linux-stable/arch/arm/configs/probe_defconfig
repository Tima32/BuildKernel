## linux-stable/drivers/fpga/probe/common_fpga/Kconfig
```kconfig
config COMMON_FPGA_DRIVER
	tristate "Probe common fpga"
	default m
	help
	  This enables the support for working with FPGA features for different platforms
```

## linux-stable/drivers/fpga/probe/etn_fpga_mgr/Kconfig
```kconfig
#
# SoC-based devices FPGA manager
#

config ETN_FPGA_MGR
        tristate "ETN FPGA manager"
        help
            etn_fpga_mgr - is an extension of Altera FPGA manager.
            New features of ETN FPGA manager:
                * FPGA features support
                * Ref counting
                * FPGA flasing at module load time
                * Kernel API
```

## linux-stable/drivers/fpga/probe/grif/ecp5_fpga_mgr/Kconfig
```kconfig
#
# Probe device configuration
#

config ECP5_FPGA_MGR
	tristate "Probe ecp5 fpga manager"
	help
	  This enables the support for the Probe ecp5 fpga manager that can firmware FPGA via SPI
```

## linux-stable/drivers/fpga/probe/grif/grif_fpga_mgr/Kconfig
```kconfig
#
# Probe device configuration
#

config GRIF_FPGA_MGR
	tristate "Grif FPGA manager"
	depends on ECP5_FPGA_MGR
	help
	  This enables the support for the grif FPGA manager that provides FPGA features control
```

## linux-stable/drivers/fpga/probe/meta_fpga_mgr/Kconfig
```kconfig
config META_FPGA_MGR
	tristate "Meta FPGA manager"
	default m
	help
	  FPGA manager driver to parse FPGA features.
```

## linux-stable/drivers/fpga/probe/mpf_fpga_mgr/Kconfig
```kconfig
config FPGA_MGR_MPF_SPI
	tristate "Microchip Polarfire SPI FPGA manager"
	depends on SPI
	default m
	help
	  FPGA manager driver support for Microchip Polarfire FPGAs
	  programming over slave SPI interface with .dat formatted
	  bitstream image.
```

## linux-stable/drivers/gpio/probe/fpga-gpio-full/Kconfig
```kconfig
#
# Probe device configuration
#

config GRIF_GPIO_EXPANDER
	tristate "Probe full GPIO expander for Grif FPGA sfp control feature"
        default m
        depends on (GRIF_FPGA_MGR || ETN_FPGA_MGR) && COMMON_FPGA_DRIVER
	help
	  This driver controls a FPGA-based GPIO expander.
```

## linux-stable/drivers/gpio/probe/gpio_exporter/Kconfig
```kconfig
config GPIO_EXPORTER
        tristate "Probe GPIO exporter"
        depends on GPIO_SYSFS
        help
          Module provides functionality for gpio naming and pre-configuring from device-tree
          
```

## linux-stable/drivers/hwmon/probe/ecp5-hwmon/Kconfig
```kconfig
config ECP5_HWMON
        tristate "Lattice ECP5 FPGA"
	depends on GRIF_FPGA_MGR
        help
          Hardware monitor driver for Lattice ECP5 FPGA.
```

## linux-stable/drivers/hwmon/probe/etn-fan/Kconfig
```kconfig
#
# Probe Etn fan driver
#

config ETN_FAN
        tristate "Etn driver for fan"
        depends on ETN_FPGA_MGR && ETN_IO
        default m
        help
            Driver to control fan. 
            It provides hwmon device in userspace to control fan.
            At this moment FPGA supports 4 modes:
                1) Off
                2) 30%
                3) 60%
                4) 100%
```

## linux-stable/drivers/hwmon/probe/probe-lm85/Kconfig
```kconfig
config SENSORS_PROBE_LM85
	tristate "National Semiconductor LM85 and compatibles (extended ADT7463)"
	depends on I2C
	select HWMON_VID
	help
	  If you say yes here you get support for National Semiconductor LM85
	  sensor chips and clones: ADM1027, ADT7463, ADT7468, EMC6D100,
	  EMC6D101, EMC6D102, and EMC6D103.

	  With extensions for ADT7463.

	  This driver can also be built as a module.  If so, the module
	  will be called probe-lm85.
```

## linux-stable/drivers/i2c/nt25l90/Kconfig
```kconfig
#
# Probe NT25L90 driver
#

config NT25L90_OPTICAL_DRIVER
        tristate "nt25l90 driver module"
        default m
```

## linux-stable/drivers/input/keyboard/probe/etn-keys/Kconfig
```kconfig
config KEYBOARD_ETN
	tristate "ETN keyboard driver"
	depends on KEYBOARD_ADP5589
	default m
	help
	  This driver implements device tree support for ADP5589 I2C Keypad.
```

## linux-stable/drivers/input/misc/probe/fpga-beeper/Kconfig
```kconfig
config FPGA_BEEPER
    tristate "PROBE FPGA beeper for devices with FPGA_FEAT_BEEPER"
    depends on ETN_FPGA_MGR && COMMON_FPGA_DRIVER
    default m
```

## linux-stable/drivers/memory/probe/etn_io/Kconfig
```kconfig
#
# SoC-based devices I/O access to FPGA reg
#

config ETN_IO
        tristate "ETN IO driver"
        depends on ETN_FPGA_MGR && COMMON_FPGA_DRIVER
        default m
        help
            ETN I/O access to FPGA register.
            This driver implements char device (actually, miscdevice) interface to FPGA
            registers.
```

## linux-stable/drivers/memory/probe/grif_io/Kconfig
```kconfig
#
# Probe device configuration
#

config GRIF_FPGA_IO 
	tristate "Grif FPGA memory controller"
	depends on GRIF_FPGA_MGR
	help
	  This enables the support for the grif FPGA memory controller that
          provides access to FPGA control/status registers via char device
```

## linux-stable/drivers/memory/probe/mem-reserve/Kconfig
```kconfig
#
# Probe Memory reserve
#

config MEM_RESERVE
        tristate "ETN memory reserve driver"
        default m
        help
            mem-reserve -- driver for using reserved-memory region.
            This driver is char device, which provides methods for accsess
            to reserved-memory region for user-space application:
                open
                write
                read
                lseek
                close
```

## linux-stable/drivers/net/ethernet/probe/etn-phc/Kconfig
```kconfig
#
# SoC-based devices PHC
#

config ETN_PHC
        tristate "ETN PHC driver"
        depends on ETN_FPGA_MGR && ETN_PHC_MUX && COMMON_FPGA_DRIVER
        default m
        help
            etn_phc -- PTP Hardware Clock (PHC) driver for SoC-based devices.
            This driver provides access to PHC clocks implemented in FPGA of SoC-based
            devices. It registers a platform driver that handles platform device with
            compatible = "etn,phc".
```

## linux-stable/drivers/net/ethernet/probe/etn_phc_mux/Kconfig
```kconfig
#
# SoC-based devices PHC MUX
#

config ETN_PHC_MUX
        tristate "ETN PHC MUX driver"
        depends on ETN_FPGA_MGR && COMMON_FPGA_DRIVER
        default m
        help
            etn-phc-mux -- driver to control mapping between network ports and PHC clocks.
            Once the driver is registered within the kernel and starts handling such device
            it creates file named separate_phc_mode in the sysfs directory of its device.
            Such a directory is usually located at /sys/bus/platform/soc/<my-device-name>.
            One can set the contents of this file to:
                1 -- switch the driver to mode with separate PTP clock being used by each NIC
                0 -- switch the driver to mode with single PTP clock being shared by the NICs (default).
```

## linux-stable/drivers/net/ethernet/probe/grif_net/Kconfig
```kconfig
#
# Probe device configuration
#

config GRIF_NET
	tristate "Probe FPGA-based NIC for Grif platform support"
        depends on GRIF_FPGA_MGR
	select PHYLINK
	help
	  This enables the support for the Probe FPGA-based NIC for Grif platform.
```

## linux-stable/drivers/net/ethernet/probe/grif_phc/Kconfig
```kconfig
#
# Probe device configuration
#

config GRIF_PHC
	tristate "Probe FPGA-based PTP Hardware Clock (PHC) for Grif platform support"
        depends on GRIF_FPGA_MGR
	help
	  This enables the support for the Probe FPGA-based PTP Hardware Clock (PHC) for Grif platform.
```

## linux-stable/drivers/net/ethernet/probe/grif_phc_mux/Kconfig
```kconfig
#
# Probe device configuration
#

config GRIF_PHC_MUX
	tristate "Probe FPGA-based PHC multiplexor for Grif platform support"
        depends on GRIF_FPGA_MGR
	help
	  This enables the support for the Probe FPGA-based PHC multiplexor for Grif platform.
```

## linux-stable/drivers/net/ethernet/probe/soc-net/Kconfig
```kconfig
config SOC_NET
	tristate "Probe FPGA-based NIC for SOC-based devices"
	depends on ETN_FPGA_MGR
	default m
	select PHYLINK
	help
	  This enables the support for the Probe FPGA-based NIC for
	  SOC-based devices.

config SOC_MDIO
	tristate "Probe FPGA-based MDIO bus for SOC-based devices"
	depends on ETN_FPGA_MGR
	default m
	help
	  This enables the support for the Probe FPGA-based MDIO bus
	  for SOC-based devices.
```

## linux-stable/drivers/net/wireless/espressif/esp8089/Kconfig
```kconfig
config ESP8089
	tristate "Espressif ESP8089 support"
	depends on MAC80211
	help
	  This adds support for Espressif ESP8089 WiFi module.
```

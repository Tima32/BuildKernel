## linux-stable/drivers/power/probe/etn-bat/Kconfig
```kconfig
#
#  SoC-based battery driver
#

config ETN_BAT
        tristate "Etn battery driver"
        default m
        help
            Driver controls power and battery.
            Driver integrates in subsystem power_supply and polls battery controller.
```

## linux-stable/drivers/power/supply/probe/etm_battery/Kconfig
```kconfig
config ETM_BATTERY
        tristate "ET-mini ADC battery driver"
        help
          Battery driver for ETM device
```

## linux-stable/drivers/video/fbdev/probe/melt_lcd/Kconfig
```kconfig
#
# Probe device configuration
#

config FB_MELT_LCD
	tristate "MELT MT-12232A LCD driver"
	help
	  This driver implements support for MELT MT-12232A LCD
```

## linux-stable/drivers/video/probe/etn-fb/Kconfig
```kconfig
#
# SoC-based devices Fb
#

config ETN_FB
        tristate "ETN Framebuffer driver"
        depends on ETN_FPGA_MGR && ETN_IO && COMMON_FPGA_DRIVER
        default m
        help
           Supports ETN Framebuffer.
```
